## ESP-IDF/sdkconfig.defaults
```kconfig
# App image is larger than the default 1M factory partition.
# CONFIG_PARTITION_TABLE_SINGLE_APP is not set
# CONFIG_PARTITION_TABLE_SINGLE_APP_LARGE is not set
# CONFIG_PARTITION_TABLE_TWO_OTA is not set
# CONFIG_PARTITION_TABLE_TWO_OTA_LARGE is not set
CONFIG_PARTITION_TABLE_CUSTOM=y
# CSV filename is set per-target (sdkconfig.defaults.esp32 / .esp32s3) so each
# board gets a partition table sized to its flash.
CONFIG_PARTITION_TABLE_OFFSET=0x8000
CONFIG_PARTITION_TABLE_MD5=y

# Board-specific flash + PSRAM settings live in the per-target defaults files,
# which IDF auto-merges on top of this one:
#   sdkconfig.defaults.esp32    -> AI Thinker ESP32-CAM   (4MB flash, quad PSRAM)
#   sdkconfig.defaults.esp32s3  -> XIAO ESP32S3 Sense     (8MB flash, octal PSRAM)
# Pick the board with the build target; the camera pin map follows it:
#   idf.py set-target esp32s3   (Seeed XIAO ESP32S3 Sense)
#   idf.py set-target esp32     (AI Thinker ESP32-CAM)
CONFIG_ESP_DEFAULT_CPU_FREQ_MHZ_160=y
CONFIG_ESP_DEFAULT_CPU_FREQ_MHZ=160

# webrtc_peer_init() runs esp_peer_pre_generate_cert() (mbedtls EC keygen,
# deep bignum call stack) directly on the main task. The 3584B default
# overflows on ESP32-S3 (wider stack frames than ESP32). 8192 gives room.
CONFIG_ESP_MAIN_TASK_STACK_SIZE=8192

# WebRTC/DTLS support used by esp_peer.
CONFIG_MBEDTLS_SSL_KEEP_PEER_CERTIFICATE=y
CONFIG_MBEDTLS_SSL_PROTO_DTLS=y
CONFIG_MBEDTLS_SSL_DTLS_SRTP=y
# esp_peer self-signs a DTLS cert via mbedtls_x509write_crt_*; IDF 6 defaults
# X509_CREATE_C off (it was on in 5.4), so enable it explicitly.
CONFIG_MBEDTLS_X509_CREATE_C=y
CONFIG_MBEDTLS_X509_CRT_WRITE_C=y
# 1ms FreeRTOS tick (matches esp_peer peer_demo). At the default 100Hz/10ms
# tick, the ICE agent's socket polling and STUN/TURN retransmit timing round to
# coarse 10ms boundaries, which slows recovery from the brief UDP packet-loss
# windows seen when gathering TURN relay candidates. 1000Hz makes that timing
# 10x finer and noticeably more reliable on lossy paths.
CONFIG_FREERTOS_HZ=1000
# CONFIG_MBEDTLS_SSL_DTLS_CONNECTION_ID is not set
# Route mbedTLS allocations to PSRAM, freeing internal RAM for camera DMA.
CONFIG_MBEDTLS_EXTERNAL_MEM_ALLOC=y

# Anedya SDK over ESP32 WiFi/MQTT.
CONFIG_CONN_ANEDYA_MQTT=y
CONFIG_AN_INTERFACE_ESP32_WIFI=y
CONFIG_AN_MAX_CONCURRENT_TXN=10
CONFIG_AN_TX_BUFFER=1024
# RX buffer also sizes the esp-mqtt task stack (stack = AN_RX_BUFFER + 3112 in
# the anedya wifi-mqtt interface). The WebRTC offer decode — base64 + inflate +
# JSON parse — runs inside the MQTT command callback on that task, so 2048
# (stack 5160) overflows on ESP32-S3. 4096 gives ~7.2KB, safe headroom.
# NOTE: anedya_txn_t embeds _rxbody[AN_RX_BUFFER], so raising this also grows
# every task that keeps a txn on its stack — the signaling tx / heartbeat task
# stacks in anedya_signaling.c are sized for 4096.
CONFIG_AN_RX_BUFFER=4096
```

## ESP-IDF/sdkconfig.defaults.esp32
```kconfig
# AI Thinker ESP32-CAM hardware: ESP32 + 4 MB flash + 4 MB quad PSRAM.
CONFIG_PARTITION_TABLE_CUSTOM_FILENAME="partitions.csv"
CONFIG_PARTITION_TABLE_FILENAME="partitions.csv"
CONFIG_ESPTOOLPY_FLASHSIZE_4MB=y
CONFIG_ESPTOOLPY_FLASHSIZE="4MB"
CONFIG_ESPTOOLPY_HEADER_FLASHSIZE_UPDATE=y
CONFIG_SPIRAM=y
CONFIG_SPIRAM_MODE_QUAD=y
CONFIG_SPIRAM_TYPE_AUTO=y
CONFIG_SPIRAM_SPEED_40M=y
CONFIG_SPIRAM_SPEED=40
CONFIG_SPIRAM_BOOT_INIT=y
CONFIG_SPIRAM_USE_MALLOC=y
CONFIG_SPIRAM_MEMTEST=y
CONFIG_SPIRAM_MALLOC_ALWAYSINTERNAL=16384
CONFIG_SPIRAM_MALLOC_RESERVE_INTERNAL=32768
CONFIG_SPIRAM_CACHE_WORKAROUND=y
CONFIG_SPIRAM_CACHE_WORKAROUND_STRATEGY_MEMW=y
CONFIG_SPIRAM_CACHE_LIBJMP_IN_IRAM=y
CONFIG_SPIRAM_CACHE_LIBMATH_IN_IRAM=y
CONFIG_SPIRAM_CACHE_LIBNUMPARSER_IN_IRAM=y
CONFIG_SPIRAM_CACHE_LIBIO_IN_IRAM=y
CONFIG_SPIRAM_CACHE_LIBTIME_IN_IRAM=y
CONFIG_SPIRAM_CACHE_LIBCHAR_IN_IRAM=y
CONFIG_SPIRAM_CACHE_LIBMEM_IN_IRAM=y
CONFIG_SPIRAM_CACHE_LIBSTR_IN_IRAM=y
CONFIG_SPIRAM_CACHE_LIBRAND_IN_IRAM=y
CONFIG_SPIRAM_CACHE_LIBENV_IN_IRAM=y
CONFIG_SPIRAM_CACHE_LIBFILE_IN_IRAM=y
CONFIG_SPIRAM_CACHE_LIBMISC_IN_IRAM=y
CONFIG_SPIRAM_BANKSWITCH_ENABLE=y
CONFIG_SPIRAM_BANKSWITCH_RESERVE=8
```

## ESP-IDF/sdkconfig.defaults.esp32s3
```kconfig
# Seeed Studio XIAO ESP32S3 Sense: ESP32-S3 + 8 MB flash + 8 MB octal PSRAM.
CONFIG_PARTITION_TABLE_CUSTOM_FILENAME="partitions.esp32s3.csv"
CONFIG_PARTITION_TABLE_FILENAME="partitions.esp32s3.csv"
CONFIG_ESPTOOLPY_FLASHSIZE_8MB=y
CONFIG_ESPTOOLPY_FLASHSIZE="8MB"
CONFIG_ESPTOOLPY_HEADER_FLASHSIZE_UPDATE=y
CONFIG_SPIRAM=y
# XIAO ESP32S3 Sense uses OCTAL SPI PSRAM (not quad). Wrong mode = no PSRAM.
CONFIG_SPIRAM_MODE_OCT=y
CONFIG_SPIRAM_TYPE_AUTO=y
CONFIG_SPIRAM_SPEED_80M=y
CONFIG_SPIRAM_SPEED=80
CONFIG_SPIRAM_BOOT_INIT=y
CONFIG_SPIRAM_USE_MALLOC=y
CONFIG_SPIRAM_MALLOC_ALWAYSINTERNAL=16384
CONFIG_SPIRAM_MALLOC_RESERVE_INTERNAL=32768
# The S3 has no PSRAM cache-corruption erratum, so the quad-chip IRAM
# workaround knobs used on the ESP32 are neither needed nor available here.
```

## anedya-esp32-cam/main/Kconfig.projbuild
```kconfig
menu "Anedya WebRTC Camera"
    config ANEDYA_DEVICE_ID
        string "Anedya Device ID"
        default ""
        help
            UUID of this device from the Anedya console (Settings → Device).

    config ANEDYA_CONNECTION_KEY
        string "Anedya Connection Key"
        default ""
        help
            Device connection key from the Anedya console.

    menu "Camera Settings"
        choice CAMERA_STREAM_FRAMESIZE
            prompt "Frame size"
            default CAMERA_FRAMESIZE_HVGA
            help
                Sensor output resolution. HVGA (480x320) is the fastest on OV3660
                at 32.6 FPS. Larger sizes reduce sensor FPS and increase frame bytes.

            config CAMERA_FRAMESIZE_96X96
                bool "96x96"
            config CAMERA_FRAMESIZE_QQVGA
                bool "QQVGA (160x120)"
            config CAMERA_FRAMESIZE_QVGA
                bool "QVGA (320x240)"
            config CAMERA_FRAMESIZE_HVGA
                bool "HVGA (480x320) — fastest on OV3660"
            config CAMERA_FRAMESIZE_VGA
                bool "VGA (640x480)"
            config CAMERA_FRAMESIZE_SVGA
                bool "SVGA (800x600)"
        endchoice

        config CAMERA_JPEG_QUALITY
            int "JPEG quality (0=best/largest, 63=worst/smallest)"
            default 25
            range 0 63
            help
                OV3660 hardware JPEG encoder quantization setting.
                Lower = better image quality but larger frame bytes = lower FPS.
                Higher = blockier image but smaller frames = higher FPS.
                Typical values: 10 (~6KB), 25 (~3-4KB), 40 (~2KB).

        config CAMERA_FB_COUNT
            int "Frame buffer count"
            default 2
            range 1 4
            help
                Number of PSRAM frame buffers. With 2+, I2S DMA runs continuously
                (double speed mode). 1 = stop/start DMA per frame (lower throughput).
                2 is the recommended minimum for live streaming.

        config CAMERA_STREAM_FPS
            int "Target stream FPS"
            default 20
            range 1 30
            help
                Software rate limiter for the JPEG stream task. Sets how often
                a frame is captured and queued for DataChannel transmission.
                The actual delivered FPS at the browser is limited by DataChannel
                bandwidth: ~600 kbps / frame_bytes_per_second.
    endmenu

    menu "WebRTC DataChannel Tuning"
        config WEBRTC_SEND_CACHE_SIZE
            int "SCTP send cache size (bytes)"
            default 8192
            range 2048 65536
            help
                SCTP send buffer — how many bytes of outgoing data SCTP holds
                while waiting for the peer receive window and congestion window.
                Must be >= 1 max frame size or every send hits WOULD_BLOCK.
                At quality=25 frames are ~3-4KB so 8192 fits one frame with slack.
                Larger = more frames can queue = higher latency bursts.

        config WEBRTC_RECV_CACHE_SIZE
            int "SCTP receive cache size (bytes)"
            default 2048
            range 512 16384
            help
                SCTP receive buffer advertised to the browser as a_rwnd.
                Browser only sends small control strings so 2048 is sufficient.

        config WEBRTC_CACHE_TIMEOUT_MS
            int "DataChannel frame discard timeout (ms)"
            default 50
            range 10 5000
            help
                How long esp_peer keeps a frame in the send cache before
                discarding it as stale. Set to one frame period (1000/FPS)
                to prevent old frames queuing up and causing latency spikes.
                Default 5000ms would let 100 frames pile up at 20 FPS.

        config WEBRTC_AGENT_RECV_TIMEOUT_MS
            int "ICE agent receive timeout (ms)"
            default 100
            range 20 1000
            help
                Maximum time the ICE agent waits on recv() per loop tick, which
                also bounds how long it waits before retransmitting a lost
                STUN/TURN request. STUN relies on FAST retransmission to punch
                through UDP packet loss, so keep this small: a lost first packet
                costs one timeout before retry. At 100ms a lost packet retries
                ~5x within 500ms; at 500ms the same loss stalls gathering for
                half a second and the relay candidate can miss the answer window.
                Do NOT raise this to "give TURN more time" — that backfires on
                lossy paths. 100ms matches the peer_demo recommendation. Raise
                only if the STUN/TURN server itself is reliably slow (consistent
                high RTT, not packet loss).
    endmenu

    menu "DataChannel Test Mode"
        config DATACHANNEL_TEST_MODE
            bool "DataChannel test mode (no camera)"
            default n
            help
                When enabled, skip camera init entirely and instead send a
                counter message ("ping NNN from esp32") over the DataChannel
                at a fixed interval. Use this to verify WebRTC signaling and
                DataChannel connectivity without needing a working camera.

        config DATACHANNEL_TEST_INTERVAL_MS
            int "DataChannel test message interval (ms)"
            default 500
            range 50 10000
            depends on DATACHANNEL_TEST_MODE
            help
                How often to send a test message when DataChannel test mode
                is enabled.
    endmenu
endmenu
```
